## hfp_mic_test/main/Kconfig.projbuild
```kconfig
menu "HFP Example Configuration"
    config EXAMPLE_SSP_ENABLED
        bool "Secure Simple Pairing"
        depends on BT_CLASSIC_ENABLED
        default y
        help
            This enables the Secure Simple Pairing. If disable this option,
            Bluedroid will only support Legacy Pairing

    config EXAMPLE_LOCAL_DEVICE_NAME
        string "This device's Bluetooth name"
        default "ESP_HFP_HF"
        help
            The name phones see when pairing.

    config EXAMPLE_PEER_DEVICE_NAME
        string "Target Device Name"
        default ""
        help
            Only used when no phone has been paired yet: discover a phone with
            exactly this Bluetooth name and connect to it. Empty (the default)
            means just wait for a phone to pair from its Bluetooth settings.

    config EXAMPLE_PEER_DEVICE_ADDR
        string "Target Device Address"
        default ""
        help
            Pin one phone to reconnect to at start-up, as "xx:xx:xx:xx:xx:xx".
            Empty (the default) reconnects to whichever paired phone connected
            last, which is what a product wants.

    config EXAMPLE_ENABLE_CONSOLE_REPL
        bool "Enable UART interactive console (REPL)"
        default y
        help
            Enable UART interactive console (REPL)

    config EXAMPLE_HFP_PCM_GPIO_SUPPORTED
        bool
        default y if IDF_TARGET_ESP32
        default n
        help
            HFP PCM GPIO signal routing is only available on ESP32.
            ESP32-S31 currently supports HCI SCO data path only.

endmenu
```
